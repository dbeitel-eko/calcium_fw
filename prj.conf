## CMakeLists.txt
```
# Copyright (c) 2026 LVGL
# SPDX-License-Identifier: Apache-2.0

cmake_minimum_required(VERSION 3.28.0)

# Board overlay loading order:
#   1. boards/pre-shield-overlays/<board>.overlay — via BOARD_EXTENSION_DIRS, applied before shield overlays
#   2. shield overlay                              — applied by west (--shield flag)
#   3. boards/<board>.overlay                      — auto-discovered by Zephyr, applied after shield overlays
list(APPEND BOARD_EXTENSION_DIRS ${CMAKE_CURRENT_SOURCE_DIR}/boards/pre-shield-overlays)

find_package(Zephyr REQUIRED HINTS $ENV{ZEPHYR_BASE})
project(calcium_firmware)

# The Editor-generated UI includes LVGL as `#include "lvgl.h"`.
zephyr_compile_definitions(LV_LVGL_H_INCLUDE_SIMPLE)

# Application sources.
FILE(GLOB app_sources src/*.c)
target_sources(app PRIVATE
    ${app_sources}
)

# Build the UI exported from the LVGL Editor. ui/CMakeLists.txt produces a
# `lib-ui` library; link it to the app and give it LVGL's include paths.
add_subdirectory(ui)
target_link_libraries(lib-ui PUBLIC zephyr_interface)
target_link_libraries(app PRIVATE lib-ui)
```

## prj.conf
```kconfig
CONFIG_MAIN_STACK_SIZE=16384
CONFIG_LOG=y
CONFIG_SHELL=y

CONFIG_LVGL=y
CONFIG_LV_Z_MEM_POOL_SIZE=49152
CONFIG_LV_Z_SHELL=y
CONFIG_LV_USE_MONKEY=y

CONFIG_DISPLAY=y
CONFIG_INPUT=y
CONFIG_LV_Z_POINTER_INPUT_MSGQ_COUNT=20

CONFIG_LV_USE_SYSMON=y
CONFIG_LV_USE_PERF_MONITOR=y

CONFIG_LV_FONT_MONTSERRAT_12=y
CONFIG_LV_FONT_MONTSERRAT_14=y
CONFIG_LV_FONT_MONTSERRAT_16=y
CONFIG_LV_FONT_MONTSERRAT_18=y
CONFIG_LV_FONT_MONTSERRAT_24=y
CONFIG_LV_USE_DEMO_WIDGETS=y

# Benchmark Demo
CONFIG_LV_USE_FONT_COMPRESSED=y

CONFIG_LV_USE_OBJ_NAME=y
CONFIG_LV_USE_TRANSLATION=y

# Added automatically by Workbench for Zephyr
#--- DEBUG PRESET - BEGIN ---#
# Set to -Og
CONFIG_DEBUG_OPTIMIZATIONS=y
# Thread awareness support
CONFIG_DEBUG_THREAD_INFO=y
# Generate stack usage per-function
CONFIG_STACK_USAGE=y
# Other options in case not set by default
CONFIG_BUILD_OUTPUT_HEX=y
CONFIG_BUILD_OUTPUT_META=y
CONFIG_OUTPUT_SYMBOLS=y
CONFIG_OUTPUT_STAT=y
CONFIG_OUTPUT_DISASSEMBLY=y
CONFIG_OUTPUT_PRINT_MEMORY_USAGE=y
#--- DEBUG PRESET - END ---#
```

## boards/ek_ra6m3.conf
```kconfig
CONFIG_LV_USE_DRAW_DAVE2D=y
CONFIG_LV_Z_MEM_POOL_SIZE=65536
CONFIG_LV_DRAW_LAYER_SIMPLE_BUF_SIZE=32768
CONFIG_LV_Z_ATTRIBUTE_MEM_ALIGN_SIZE=64
CONFIG_DMA=y

# RA6M3: SDRAM bus pins (P101-P107, P111-P115, P301-P303, P608-P610) overlap
# with GLCDC LCD_DATA pins. SDRAM and GLCDC cannot be active simultaneously.
# Frame buffer and LVGL VDB stay in internal SRAM (640KB total).
#
# Memory budget: 1×255 KB (FB) + 2×26 KB (VDB) + ~101 KB (other) ≈ 408 KB
#   (frees ≈ 215 KB vs the previous FB_NUM=0 double-VDB setup).
#
# FB_NUM=1: one 255 KB driver-managed framebuffer that GLCDC always reads from.
#   Enables partial writes so LVGL can update individual dirty regions without
#   redrawing the full screen.  No vsync buffer-swap in steady state; the GLCDC
#   reads fb_background in-place while the flush thread writes to it — possible
#   tearing on large rapid updates, acceptable for mostly-static UIs.
# PARTIAL_REFRESH + VDB_SIZE=10: LVGL only redraws dirty regions (at most ~27
#   rows per strip).  Each strip is blitted to the framebuffer via
#   display_write().  VDB_SIZE strictly < 100 ensures every write is partial
#   (height < 272) so the full-screen branch in the driver is never taken, the
#   GLCDC framebuffer pointer never changes, and fb_background stays live.
# DOUBLE_VDB: two small VDBs let the flush thread blit one strip while LVGL
#   renders the next in parallel.
# VDB_ALIGN=64: LVGL draw operations may use DMA; 64-byte source alignment is
#   required.  Note: fb_background is only __aligned(8) in the driver — if the
#   linker does not place it at a 64-byte boundary the image will shift
#   horizontally by (fb_background % 64) / 2 pixels.  Verify with:
#     nm -S build/zephyr/zephyr.elf | grep fb_background
CONFIG_RENESAS_RA_GLCDC_FB_NUM=1
CONFIG_LV_COLOR_FORMAT_RGB565=y
CONFIG_LV_Z_PARTIAL_REFRESH=y
CONFIG_LV_Z_VDB_SIZE=10
CONFIG_LV_Z_DOUBLE_VDB=y
CONFIG_LV_Z_VDB_ALIGN=64

# Enable real CPU-load measurement so lv_os_get_idle_percent() returns actual
# idle% instead of always 0.  Without this, the LVGL sysmon calls
# lv_os_get_idle_percent() which unconditionally returns 0 → CPU always 100%.
# CPU_LOAD selects TRACING, resolved to the null backend (tracing_none.c):
# it times idle-thread entry/exit via k_cycle_get_32() — negligible overhead.
CONFIG_CPU_LOAD=y

# Debug console via J-Link RTT (Segger module required).
# Remove or set UART_CONSOLE=y / RTT_CONSOLE=n to switch back to UART.
CONFIG_USE_SEGGER_RTT=y
CONFIG_RTT_CONSOLE=y
CONFIG_UART_CONSOLE=n
```

## boards/ek_ra8d1.conf
```kconfig
CONFIG_LV_Z_MEM_POOL_SIZE=245760
CONFIG_LV_DRAW_LAYER_SIMPLE_BUF_SIZE=49152
CONFIG_LV_Z_ATTRIBUTE_MEM_ALIGN_SIZE=64
```

## boards/ek_ra8d2_r7ka8d2kflcac_cm85.conf
```kconfig
CONFIG_LV_Z_MEM_POOL_SIZE=245760
CONFIG_LV_DRAW_LAYER_SIMPLE_BUF_SIZE=49152
CONFIG_LV_Z_ATTRIBUTE_MEM_ALIGN_SIZE=64
```

## boards/native_sim.conf
```kconfig
# Copyright (c) 2026 LVGL
# SPDX-License-Identifier: Apache-2.0

CONFIG_LV_COLOR_FORMAT_XRGB8888=y
```

## boards/native_sim_native_64.conf
```kconfig
# Copyright (c) 2026 LVGL
# SPDX-License-Identifier: Apache-2.0

CONFIG_LV_COLOR_FORMAT_XRGB8888=y
CONFIG_LV_Z_MEM_POOL_SIZE=81920
```

## src/main.c
```c
/*
 * Copyright (c) 2026 LVGL
 *
 * SPDX-License-Identifier: Apache-2.0
 */

#include <zephyr/kernel.h>
#include <zephyr/drivers/display.h>
#include <lvgl.h>
#include <lvgl_mem.h>
#include <lvgl_zephyr.h>
#include <stdio.h>

#include "../ui/ui.h"

#define LOG_LEVEL CONFIG_LOG_DEFAULT_LEVEL
#include <zephyr/logging/log.h>
LOG_MODULE_REGISTER(app);

int main(void)
{
	const struct device *display_dev;
	int ret;

	display_dev = DEVICE_DT_GET(DT_CHOSEN(zephyr_display));
	if (!device_is_ready(display_dev)) {
		LOG_ERR("Display device not ready, aborting");
		return 0;
	}

	/* LVGL is initialized by the Zephyr LVGL module before main() runs.
	 * The lock protects LVGL state from concurrent access, e.g. by the
	 * shell or a rendering workqueue.
	 */
	lvgl_lock();

	ui_init("A:");
  lv_screen_load(screen_components_create());

#ifndef CONFIG_LV_Z_RUN_LVGL_ON_WORKQUEUE
	lv_timer_handler();
#endif
	lvgl_unlock();

	ret = display_blanking_off(display_dev);
	if (ret < 0 && ret != -ENOSYS) {
		LOG_ERR("Failed to turn blanking off (error %d)", ret);
		return 0;
	}

#ifdef CONFIG_LV_Z_MEM_POOL_SYS_HEAP
	lvgl_print_heap_info(false);
#else
	printf("lvgl in malloc mode\n");
#endif

	while (1) {
#ifdef CONFIG_LV_Z_RUN_LVGL_ON_WORKQUEUE
		/* LVGL is driven by a dedicated workqueue */
		k_msleep(10);
#else
		uint32_t sleep_ms;

		lvgl_lock();
		sleep_ms = lv_timer_handler();
		lvgl_unlock();

		k_msleep(MIN(sleep_ms, 10));
#endif
	}

	return 0;
}
```
